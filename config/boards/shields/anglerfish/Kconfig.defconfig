## config/boards/shields/anglerfish/Kconfig.defconfig
```kconfig
if SHIELD_ANGLERFISH_LEFT

    config ZMK_KEYBOARD_NAME
        default "Anglerfish"

    config ZMK_SPLIT_BLE_ROLE_CENTRAL
        default y

endif # LEFT


if SHIELD_ANGLERFISH_LEFT || SHIELD_ANGLERFISH_RIGHT

    config ZMK_SPLIT
        default y

endif # LEFT RIGHT
```

## config/boards/shields/anglerfish/Kconfig.shield
```kconfig
config SHIELD_ANGLERFISH_CENTRAL_DONGLE
    def_bool $(shields_list_contains,anglerfish_central_dongle)

config SHIELD_ANGLERFISH_CENTRAL_LEFT
    def_bool $(shields_list_contains,anglerfish_central_left)
    
config SHIELD_ANGLERFISH_PERIPHERAL_LEFT
    def_bool $(shields_list_contains,anglerfish_peripheral_left)

config SHIELD_ANGLERFISH_PERIPHERAL_RIGHT
    def_bool $(shields_list_contains,anglerfish_peripheral_right)
```

## config/boards/shields/epaper_display/Kconfig.shield
```kconfig
# Copyright (c) 2022 The ZMK Contributors
# SPDX-License-Identifier: MIT

config SHIELD_EPAPER_DISPLAY
    def_bool $(shields_list_contains,epaper_display)
```
